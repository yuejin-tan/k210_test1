/* Copyright 2018 Canaan Inc.
 *
 * Licensed under the Apache License, Version 2.0 (the "License");
 * you may not use this file except in compliance with the License.
 * You may obtain a copy of the License at
 *
 *     http://www.apache.org/licenses/LICENSE-2.0
 *
 * Unless required by applicable law or agreed to in writing, software
 * distributed under the License is distributed on an "AS IS" BASIS,
 * WITHOUT WARRANTIES OR CONDITIONS OF ANY KIND, either express or implied.
 * See the License for the specific language governing permissions and
 * limitations under the License.
 */
#include <stdio.h>
#include "dvp.h"
#include "plic.h"
#include "sysctl.h"
#include "malloc.h"

#include "ov2640.h"

const uint8_t ov2640_config[][2] =
{
    {0xff, 0x01},
    {0x12, 0x80},
    {0xff, 0x00},
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    {0x00, 0x00}
};


uint32_t* display_buf = NULL;
volatile uint8_t g_dvp_finish_flag;

/* dvp中断回调函数 */
static int on_dvp_irq_cb(void* ctx)
{
    /* 读取DVP中断状态，如果完成则刷新显示地址的数据，并清除中断标志，否则读取摄像头数据*/
    if (dvp_get_interrupt(DVP_STS_FRAME_FINISH))
    {
        dvp_set_display_addr((uint32_t)display_buf);
        dvp_clear_interrupt(DVP_STS_FRAME_FINISH);
        g_dvp_finish_flag = 1;
    }
    else
    {
        if (g_dvp_finish_flag == 0)
            dvp_start_convert();
        dvp_clear_interrupt(DVP_STS_FRAME_START);
    }
    return 0;
}


/* 读取ov2640的地址 */
int ov2640_read_id(uint16_t* manuf_id, uint16_t* device_id)
{
    dvp_sccb_send_data(OV2640_ADDR, 0xFF, 0x01);
    *manuf_id = (dvp_sccb_receive_data(OV2640_ADDR, 0x1C) << 8) | dvp_sccb_receive_data(OV2640_ADDR, 0x1D); //读制造商标识符
    *device_id = (dvp_sccb_receive_data(OV2640_ADDR, 0x0A) << 8) | dvp_sccb_receive_data(OV2640_ADDR, 0x0B); //读PID和VER
    return 0;
}

static int OVxxxx_id_check(void) //只适用OV9655和2640
{
    uint16_t manuf_id = 0;
    uint16_t device_id = 0;

    ov2640_read_id(&manuf_id, &device_id);
    printf("manuf_id:0x%04x,device_id:0x%04x\r\n", manuf_id, device_id);

    if (device_id == 0x9657 || device_id == 0x9656)//OV9655
    {
        printf("This is the OV9655 camera\r\n");
        return 1;
    }
    else if (device_id == 0x2642)//OV2640
    {
        printf("This is the OV2640 camera\r\n");
        return 0;
    }
    else
    {
        printf("Camera failure\r\n");
        return 1;
    }

    return 1;
}

/* 初始化ov2640摄像头 */
int ov2640_init(void)
{
    /* DVP初始化，设置sccb的寄存器长度为8bit */
    dvp_init(8);
    /* 设置输入时钟为24000000*/
    dvp_set_xclk_rate(24000000);
    /* 使能突发传输模式 */
    dvp_enable_burst();
    /* 关闭AI输出模式，使能显示模式 */
    dvp_set_output_enable(DVP_OUTPUT_AI, 0);
    dvp_set_output_enable(DVP_OUTPUT_DISPLAY, 1);
    /* 设置输出格式为RGB */
    dvp_set_image_format(DVP_CFG_RGB_FORMAT);
    /* 设置输出像素大小为320*240 */
    dvp_set_image_size(CAM_WIDTH_PIXEL, CAM_HIGHT_PIXEL);

    /* 设置DVP的显示地址参数和中断 */
    display_buf = (uint32_t*)malloc(CAM_WIDTH_PIXEL * CAM_HIGHT_PIXEL * 2);
    dvp_set_display_addr((uint32_t)display_buf);
    dvp_config_interrupt(DVP_CFG_START_INT_ENABLE | DVP_CFG_FINISH_INT_ENABLE, 0);
    dvp_disable_auto();

    /* DVP 中断配置：中断优先级，中断回调，使能DVP中断 */
    printf("DVP interrupt config\r\n");
    plic_set_priority(IRQN_DVP_INTERRUPT, 1);
    plic_irq_register(IRQN_DVP_INTERRUPT, on_dvp_irq_cb, NULL);
    plic_irq_enable(IRQN_DVP_INTERRUPT);

    /* 清除DVP中断位 */
    g_dvp_finish_flag = 0;
    dvp_clear_interrupt(DVP_STS_FRAME_START | DVP_STS_FRAME_FINISH);
    dvp_config_interrupt(DVP_CFG_START_INT_ENABLE | DVP_CFG_FINISH_INT_ENABLE, 1);

    // 读取ov2640 ID
    if (OVxxxx_id_check())
        return 1;

    // 配置ov2640
    uint16_t index = 0;
    for (index = 0; ov2640_config[index][0]; index++)
        dvp_sccb_send_data(OV2640_ADDR, ov2640_config[index][0], ov2640_config[index][1]);

    return 0;
}
